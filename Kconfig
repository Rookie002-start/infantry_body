## inter_cmd/Kconfig
```kconfig
config INTER_CMD
    bool "Inter-board command interface"
    default y
    select DUST_TPC_TO_MCU_TX
    help
      Shared command interface for the upper/lower board link.
      Requires the to_mcu_tx topic channel.
```

## modules/dbg/Kconfig
```kconfig
# modules/dbg —— 公共调参终端

config DBG
	bool "Tuning shell (RTT: pid ...)"
	default n
	select DUST_CTL_PID
	select UART_INTERRUPT_DRIVEN
	help
	  通用调参终端：RTT 里收命令行，改**任何登记过的双环 PID**，不重新烧录即可整定。
	  云台两条轴用的就是这套命令（底盘是单速度环，不登记）。

	  业务侧只 include dbg.hpp（模块提供 include 路径），初始化时登记：
	    dbg::RegisterPid({"gimbal", "yaw", &axis.position, &axis.omega});
	  dbg 侧完全不认识业务类型；关掉本开关时登记调用编译成空操作，业务线程照常独立跑。

	  命令：help / pid / pid <group> [<axis>] / pid <g> <a> in|out <kp> <ki> /
	        pid <g> <a> mon <ms>

	  输入口：RTT 下行缓冲（tools/rtt.sh + nc localhost 9090）；
	          可选控制台串口 RX，见 DBG_UART_RX。

config DBG_UART_RX
	bool "Tuning shell also listens on the console UART RX"
	default n
	depends on DBG
	help
	  **默认关**：只从 RTT 下行缓冲收命令（在看日志的同一个窗口里敲即可）。

	  打开后额外在 zephyr,console（dm_mc02 = usart3）上挂 RX 中断收命令。默认关是有意的：
	  console 是日志口，往它上面挂 RX 中断等于和日志子系统共用一路串口的中断，台架上 RX
	  悬空/有噪声时多一份不确定性；RTT 那条路已经够用，需要串口调参时再单独打开。
```

## modules/vofa+/Kconfig
```kconfig
# modules/vofa+ —— VOFA+ 波形输出组件（JustFloat 协议）

config VOFA
	bool "VOFA+ JustFloat output"
	default n
	select SERIAL
	select UART_INTERRUPT_DRIVEN
	help
	  把 float 通道按 JustFloat 协议发到 VOFA+ 上位机看波形：
	  一帧 = n × 4 字节小端 float + 4 字节帧尾 {00 00 80 7F}。

	  串口取设备树别名 vofa-uart（dm_mc02 上 = uart7，921600 8N1）。
	  发送走 TX 中断 + 环形缓冲，组帧只 memcpy 一份就返回，所以可以直接
	  在 1ms 控制环里调；缓冲放不下就丢整帧，不阻塞调用者。

	  初始化（挂 TX 中断回调、建环形缓冲）只由所有者组件
	  thread/vofa/trd_vofa.cpp（CONFIG_TRD_VOFA）在启动阶段做一次，
	  业务线程只调 vofa::Send()，不要自己调 vofa::Init()。

	  板卡没有 vofa-uart 别名时组件照常编译，只是 Init() 失败、Send() 空转。
```

## my_topic/Kconfig
```kconfig
config DUST_TPC_TO_MCU_TX
    default n
    bool "CAN TX queue"
    help
        MCU transmit message queue (upper/lower board), selected by TRD_MCU_INTER.

config DUST_TPC_FROM_HEAD
    default n
    bool "Upper board RX channel"
    select ZBUS
    select INTER_CMD
    help
        Received data contract from the upper board: state channel (zbus).
        Selected by TRD_INTER_RX./TRD_CHASSIS.
        from_head.hpp 复用 inter_cmd.hpp 的结构体，故这里一并 select INTER_CMD
        （INTER_CMD 提供该头文件的 include 路径与 to_mcu_tx 依赖）。

config DUST_TPC_GIMBAL_TO
    default n
    bool "Gimbal to channel"
    select ZBUS
    help
        Gimbal transmit data channel.
```
